## arch/arm/mach-rockchip/rv1106/Kconfig
```kconfig
if ROCKCHIP_RV1106

config TARGET_EVB_RV1106
	bool "EVB_RV1106"
	help
	  RV1106 EVB is a evaluation board for Rockchp RV1106.

config SYS_SOC
	default "rv1106"

source board/rockchip/evb_rv1106/Kconfig

config TPL_LDSCRIPT
	default "arch/arm/mach-rockchip/u-boot-tpl.lds"

config TPL_TEXT_BASE
	default 0xff701000

config TPL_MAX_SIZE
	default 32768

config SOC_SPECIFIC_OPTIONS # dummy
	def_bool y
	select HAS_CUSTOM_SYS_INIT_SP_ADDR

config ROCKCHIP_BOOT_MODE_REG
	default 0xff020200

config ROCKCHIP_STIMER_BASE
	default 0xff590020

config CUSTOM_SYS_INIT_SP_ADDR
	default 0x800000

config SPL_STACK
	default 0x001fe000

config SPL_STACK_R_ADDR
	default 0x800000

config SYS_MALLOC_F_LEN
	default 0x2000

#config TEXT_BASE
#	default 0x600000

endif
```

## configs/evb-rv1106_defconfig
```kconfig
CONFIG_ARM=y
CONFIG_SPL_SKIP_LOWLEVEL_INIT_ONLY=y
CONFIG_TPL_SKIP_LOWLEVEL_INIT_ONLY=y
CONFIG_COUNTER_FREQUENCY=24000000
CONFIG_SYS_ARCH_TIMER=y
CONFIG_ARCH_ROCKCHIP=y
CONFIG_NR_DRAM_BANKS=2
CONFIG_DEFAULT_DEVICE_TREE="rockchip/rv1106-luckfox-core1106-pico-pi-w"
CONFIG_SYS_MONITOR_LEN=614400
CONFIG_ROCKCHIP_RV1106=y
CONFIG_TARGET_EVB_RV1106=y
CONFIG_SYS_BOOTM_LEN=0x4000000
CONFIG_SYS_LOAD_ADDR=0xe00800
CONFIG_FIT_VERBOSE=y
CONFIG_SPL_LOAD_FIT=y
CONFIG_DEFAULT_FDT_FILE="rockchip/rv1106-luckfox-core1106-pico-pi-w.dtb"
CONFIG_DISPLAY_BOARDINFO_LATE=y
CONFIG_SPL_NO_BSS_LIMIT=y
CONFIG_CMD_GPT=y
CONFIG_CMD_MMC=y
CONFIG_ROCKCHIP_GPIO=y
CONFIG_SYS_I2C_ROCKCHIP=y
CONFIG_MISC=y
CONFIG_MMC_DW=y
CONFIG_MMC_DW_ROCKCHIP=y
CONFIG_SYSRESET=y
CONFIG_SPL_TINY_MEMSET=y
CONFIG_LZO=y
CONFIG_ERRNO_STR=y


# This is not needed with `rockchip: Move TEXT_BASE to 8 MiB offset from start of DRAM`
CONFIG_TEXT_BASE=0x00800000

# ADC ref voltage
CONFIG_DM_REGULATOR_FIXED=y

CONFIG_EFI_LOADER=n
CONFIG_DEBUG_UART_BOARD_INIT=n

CONFIG_USB=y
CONFIG_USB_GADGET=y
CONFIG_DM_USB_GADGET=y
CONFIG_USB_DWC3=y
CONFIG_USB_DWC3_GADGET=y
CONFIG_USB_DWC3_GENERIC=y

CONFIG_PHY_ROCKCHIP_INNO_USB2=y

CONFIG_USB_FUNCTION_FASTBOOT=n
CONFIG_USB_GADGET_DOWNLOAD=y
CONFIG_USB_FUNCTION_MASS_STORAGE=y
CONFIG_CMD_USB_MASS_STORAGE=y

CONFIG_ROCKCHIP_BOOT_MODE_ADC_CHAN=0

CONFIG_WATCHDOG=y
CONFIG_WDT=y
CONFIG_WATCHDOG_AUTOSTART=y
CONFIG_WATCHDOG_TIMEOUT_MSECS=30000
CONFIG_DESIGNWARE_WATCHDOG=y
CONFIG_CMD_WDT=y

CONFIG_SPL_SYS_MALLOC_F_LEN=0x110000
CONFIG_SPL_ENV_SUPPORT=y
CONFIG_SPL_ENV_IS_NOWHERE=y
CONFIG_SPL_DM_USB_GADGET=y
CONFIG_SPL_PHY=y
CONFIG_SPL_PHY_ROCKCHIP_INNO_USB2=y
CONFIG_SPL_USB_GADGET=y
CONFIG_SPL_USB_DWC3_GENERIC=y

CONFIG_CMD_DFU=y
CONFIG_DFU=y
CONFIG_DFU_OVER_USB=y
CONFIG_DFU_RAM=y
CONFIG_SYS_DFU_DATA_BUF_SIZE=0x100000
CONFIG_SYS_DFU_MAX_FILE_SIZE=0x200000
CONFIG_SPL_DFU=y
CONFIG_SPL_DFU_RAM=y

# development options
CONFIG_TOOLS_MKEFICAPSULE=n
CONFIG_ROCKCHIP_MASKROM_IMAGE=y
```
