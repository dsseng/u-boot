// SPDX-License-Identifier: (GPL-2.0+ OR MIT)
/*
 * Copyright (c) 2022 Rockchip Electronics Co., Ltd.
 */

/dts-v1/;

#include "rv1106-luckfox-core1106.dtsi"

/ {
	model = "Luckfox Pico Pi";
	compatible = "luckfox,core1106-pico-pi-w", "luckfox,core1106", "rockchip,rv1106";
};

&u2phy {
	status = "okay";
};

&u2phy_otg {
	status = "okay";
};

&usbdrd_dwc3 {
	status = "okay";
	usb-role-switch;
};
